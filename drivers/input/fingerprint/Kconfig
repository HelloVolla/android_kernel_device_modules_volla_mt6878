## drivers/input/fingerprint/Kconfig
```kconfig
#
#Fingerprint
#
menuconfig INPUT_FINGERPRINT
	bool "fingerprint"
	help
	  Say Y here, and a list of supported fingerprint will be displayed.
	  This option doesn't affect the kernel.

	  If unsure, say Y.

if INPUT_FINGERPRINT
config MTK_FINGERPRINT_SUPPORT
	bool "Mediatek Fingerprint"
	default n
	help
	  Fingerprint mtk driver enable/disable
	  in the kernel.Say Y here if you want to
	  use mediatek fingerprint driver,fingerprint
	  driver will support fingerprint function

config MTK_FINGERPRINT_SELECT
	string "sensor type"
	default "NA"

config PRIZE_FP_USE_VFP
	bool "Fingerprint power vfp"
	default n
	help
	  CHIPONE fingerprint CHIPONE's device.

source "$(KCONFIG_EXT_PREFIX)drivers/input/fingerprint/goodix-gw9518/Kconfig"
source "$(KCONFIG_EXT_PREFIX)drivers/input/fingerprint/focaltech_ree_ata/Kconfig"
source "$(KCONFIG_EXT_PREFIX)drivers/input/fingerprint/doogee/Kconfig"
source "$(KCONFIG_EXT_PREFIX)drivers/input/fingerprint/pri_finger_ftm_node/Kconfig"
endif
```

## drivers/input/fingerprint/doogee/Kconfig
```kconfig
#
#Fingerprint
#
if INPUT_FINGERPRINT
config PRI_FP_DOOGEE_CUSTOMER
	bool "pri fp doogee customer"
	default n
	help
	  Fingerprint fp doogee customer driver enable/disable

source "$(KCONFIG_EXT_PREFIX)drivers/input/fingerprint/doogee/ft9391_tee/Kconfig"
endif
```

## drivers/input/touchscreen/focaltech_ft8722_spi/Kconfig
```kconfig
#
# Focaltech Touchscreen driver configuration
#

config TOUCHSCREEN_FOCALTECH_FT8722_SPI
    tristate "Focaltech Touchscreen"
    default m
    help
      Say Y here if you have Focaltech touch panel.
      If unsure, say N.
```

## drivers/input/touchscreen/hynitron_cst9xx/Kconfig
```kconfig
#
# hyn Touchscreen driver configuration
#

config TOUCHSCREEN_HYN
    tristate "hyn Touchscreen"
    default m
    help
      Say Y here if you have hyn touch panel.
      If unsure, say N.
```

## drivers/misc/mediatek/sec-nfc/Kconfig
```kconfig
#
# Near Field Communication (NFC) devices
#

menu "Near Field Communication (NFC) devices"
        depends on NFC

source "$(KCONFIG_EXT_PREFIX)drivers/misc/mediatek/sec-nfc/samsung/Kconfig"
endmenu
```
